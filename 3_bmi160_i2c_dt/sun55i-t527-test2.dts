/dts-v1/;
/plugin/;

/ {
	compatible = "allwinner,sun55i-t527";
    fragment@0 {
        target-path = "/";
         __overlay__ {
            dt-test@0{
                compatible = "walnutpi-test";
                status = "okay";
            };
        };
    };
};

