/dts-v1/;
/plugin/;
// #include <dt-bindings/gpio/gpio.h>
// #include <dt-bindings/gpio/sun4i-gpio.h>
// #include <dt-bindings/leds/common.h>
// / {
// 	// compatible = "allwinner,sun55i-t527";
// 	// 	fragment@0 {
// 	// 	target = <&pio>;
// 	// 	__overlay__ {
// 	// 		bmi160_pins_default: twi1@0 {
// 	// 			pins = "PB4", "PB5";
// 	// 			function = "twi1";
// 	// 			drive-strength = <10>;
// 	// 			bias-pull-up;
// 	// 		};
// 	// 	};
// 	// };
// 	fragment@0 {
// 		target = <&twi1>;
// 		__overlay__ {
// 			#address-cells = <1>;
// 			#size-cells = <0>;
// 			status = "okay";
// 			bmi160@0 {
// 				compatible = "barco,bmi160";
// 				clock-frequency = <400000>;
// 				// pinctrl-0 = <&bmi160_pins_default>;
// 				// pinctrl-names = "default";
// 				// twi_drv_used = <1>;
// 				reg = <0>;
// 				status = "okay";
// 			};
// 		};
// 	};

// 	// fragment@2 {
// 	// 	target = <&twi1>;
// 	// 	__overlay__ {
// 	// 		status = "disable";
// 	// 	};
// 	// };
// };

/ {
        fragment@0 {
                target = <&spi1>;
                __overlay__ {
                        #address-cells = <1>;
                        #size-cells = <0>;
                        status = "okay";
                        bmi160@0{
                                compatible = "walnutpi,lcd15_st7789";
                                reg = <0>;
                                spi-max-frequency = <30000000>;
                                status = "okay";

                                dc-gpios = <&pio  8 9 0>;
                                reset-gpios = <&pio 8 7 1>;
                                rotate = <270>;
                                buswidth = <8>;
                                regwidth = <10>;
                                fps = <30>;
                                bgr = <0> ;
                                debug = <0x00>;
                        };

                };
        };

        fragment@1 {
                target = <&spi1>;
                __overlay__ {
                        status = "okay";
                        #address-cells = <1>;
                        #size-cells = <0>;

                        spidev@0 {
                                status = "disabled";
                                reg = <0x0>;
                        };

                        spidev@1 {
                                status = "disabled";
                                reg = <0x1>;
                        };
                };
        };
};

