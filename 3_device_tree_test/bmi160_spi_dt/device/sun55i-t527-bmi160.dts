/dts-v1/;
/plugin/;

/ {
	compatible = "allwinner,sun55i-t527";
    fragment@0 {
        target = <&spi1>;  /* 根据实际情况修改 SPI 控制器编号 */
        __overlay__ {
            #address-cells = <1>;
            #size-cells = <0>;
            status = "okay";
            bmi160@0 {  /* CS 片选信号编号，通常 BMI160 使用 CS0 */
                compatible = "barco,bmi160";
                reg = <0>;  /* SPI 片选信号编号 */
                spi-max-frequency = <2000000>;  /* 5MHz，可根据需要调整 */
                /* 设置每个字为8位（默认是8位） */
                bits-per-word = <8>;
                /** endian = "big"; */             /* 大端字节序 */
                /* endian = "little"; */
                spi-msb-first;
                /* 绕Z轴旋转180度 */
                /** orientation = < -1 0 0 0 -1 0 0 0 1 >; */

                /** spi-cpol：指定时钟极性（CPOL）
                    存在该属性表示 CPOL=1（空闲时 SCK 为高电平）
                    不存在该属性表示 CPOL=0（空闲时 SCK 为低电平）
                    spi-cpha：指定时钟相位（CPHA）
                    存在该属性表示 CPHA=1（数据在 SCK 的第二个边沿采样）
                    不存在该属性表示 CPHA=0（数据在 SCK 的第一个边沿采样）
                */
                spi-cpol;
                spi-cpha;
                /* 中断配置 (如果使用中断) */
                // int-gpios = <&gpio0 10 GPIO_ACTIVE_LOW>;  /* 中断引脚，根据实际情况修改 */
                
                /* FIFO 水线配置 (可选) */
                // fifo-watermark = <64>;  /* FIFO 触发阈值 */
                
                /* 唤醒延迟 (可选) */
                // wakeup-delay-ms = <10>;  /* 唤醒延迟时间 (毫秒) */
                
                status = "okay";
            };
        };
    };
};

