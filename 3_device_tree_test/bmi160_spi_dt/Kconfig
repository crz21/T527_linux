## 3_device_tree_test/bmi160_spi_dt/Kconfig
```kconfig
mainmenu "bmi160 spi dt config "

menu "Select SoC"

    config ENABLE_T527
        bool "Enable T527"
        default n
        help
            if enable t527, then disable rk3576

    config ENABLE_RK3576
        bool "Enable RK3576"
        default y
        help
            if enable rk3576, then disable t527
endmenu
```

## 3_device_tree_test/bmi160_spi_dt/device/Kconfig
```kconfig
config BMI160
    tristate "BMI160 IMU sensor support"
    depends on IIO
    help
      This enables support for the Bosch BMI160 sensor.

# config BMI160_SPI
#     tristate "barco BMI160 I2C driver"
#     depends on SPI
#     default m
#     help
#         If you say yes here you get support for BMI160 IMU on SPI with
#         accelerometer, gyroscope and external BMG160 magnetometer.

#         This driver can also be built as a module. If so, the module will be
#         called bmi160_spi.
```

## 3_device_tree_test/bmi160_spi_dt_csv/Kconfig
```kconfig
mainmenu "bmi160 spi dt config "

menu "Select SoC"

choice
    
    prompt "Select ont option"
    default ENABLE_RK3576
    help
      This is a choice between several mutually exclusive options.

    config ENABLE_T527
        bool "Enable T527"
    
    config ENABLE_RK3576
        bool "Enable RK3576"

endchoice

endmenu
```

## 4_kconfig_test/bmi160_i2c_kconfig/Kconfig
```kconfig
#
# For a description of the syntax of this configuration file,
# see scripts/kbuild/config-language.txt.
#
mainmenu "Users Configuration"

# menu "Applications Settings"

source "menu_demo/Kconfig"

 config HELLO MODULE
 tristate "hello-tristate"
 default y
 help
    this is help test
```

## bmi160_spi_dt/device/Kconfig
```kconfig
choice 
	bool
	prompt "select SoC"

config T527
	bool
	prompt "select T527"

config RK3576
	bool
	prompt "select RK3576"

endchoice
```
